## config/west.yml
```yaml
manifest:
  remotes:
    - name: zmkfirmware
      url-base: https://github.com/zmkfirmware
    - name: boardsource
      url-base: https://github.com/boardsource
  projects:
    - name: zmk
      remote: zmkfirmware
      revision: v0.3.0
      import: app/west.yml
    - name: Rechtek-zmk-config
      remote: boardsource
      revision: main
  self:
    path: config
```
